/* Copyright (c) 2019, The Linux Foundation. All rights reserved.
 *
 * This program is free software; you can redistribute it and/or modify
 * it under the terms of the GNU General Public License version 2 and
 * only version 2 as published by the Free Software Foundation.
 *
 * This program is distributed in the hope that it will be useful,
 * but WITHOUT ANY WARRANTY; without even the implied warranty of
 * MERCHANTABILITY or FITNESS FOR A PARTICULAR PURPOSE.  See the
 * GNU General Public License for more details.
 */

&mdss_mdp {
	dsi_rm69299_amoled_p710_cmd:
		qcom,mdss_dsi_rm69299_amoled_p710_cmd {
		qcom,mdss-dsi-panel-name =
			"rm69299 amoled 720 1520 cmd";
		qcom,mdss-dsi-panel-type = "dsi_cmd_mode";

		qcom,mdss-dsi-virtual-channel-id = <0>;
		qcom,mdss-dsi-stream = <0>;
		qcom,mdss-dsi-bpp = <24>;
		qcom,mdss-dsi-color-order = "rgb_swap_rgb";
		qcom,mdss-dsi-underflow-color = <0xff>;
		qcom,mdss-dsi-border-color = <0>;
		qcom,mdss-dsi-panel-orientation = "180";
		qcom,mdss-dsi-h-sync-pulse = <0>;
		qcom,mdss-dsi-traffic-mode = "non_burst_sync_event";
		qcom,mdss-dsi-lane-map = "lane_map_0123";
		qcom,mdss-dsi-bllp-eof-power-mode;
		qcom,mdss-dsi-bllp-power-mode;
		qcom,mdss-dsi-tx-eot-append;
		qcom,mdss-dsi-lane-0-state;
		qcom,mdss-dsi-lane-1-state;
		qcom,mdss-dsi-lane-2-state;
		qcom,mdss-dsi-lane-3-state;
		qcom,mdss-dsi-dma-trigger = "trigger_sw";
		qcom,mdss-dsi-mdp-trigger = "none";
		qcom,mdss-dsi-lp11-init;
		qcom,mdss-dsi-bl-pmic-control-type = "bl_ctrl_dcs";
		qcom,mdss-dsi-reset-sequence = <1 10>, <0 10>, <1 10>;
		qcom,mdss-dsi-te-pin-select = <1>;
		qcom,mdss-dsi-wr-mem-start = <0x2c>;
		qcom,mdss-dsi-wr-mem-continue = <0x3c>;
		qcom,mdss-dsi-te-dcs-command = <1>;
		qcom,mdss-dsi-te-check-enable;
		qcom,mdss-dsi-te-using-te-pin;

		qcom,mdss-dsi-display-timings {
			timing@0 {
				qcom,mdss-dsi-panel-width = <720>;
				qcom,mdss-dsi-panel-height = <1520>;
				qcom,mdss-dsi-h-front-porch = <32>;
				qcom,mdss-dsi-h-back-porch = <32>;
				qcom,mdss-dsi-h-pulse-width = <8>;
				qcom,mdss-dsi-h-sync-skew = <0>;
				qcom,mdss-dsi-v-back-porch = <8>;
				qcom,mdss-dsi-v-front-porch = <16>;
				qcom,mdss-dsi-v-pulse-width = <17>;
				qcom,mdss-dsi-panel-framerate = <60>;
				qcom,mdss-dsi-on-command = [
					39 01 00 00 00 00 02 FE 00
					39 01 00 00 00 00 02 C2 08
					39 01 00 00 00 00 02 35 00
					39 01 00 00 00 00 02 51 FF
					05 01 00 00 96 00 02 11 00
					05 01 00 00 32 00 02 29 00];
				qcom,mdss-dsi-off-command = [
					05 01 00 00 32 00 02 28 00
					05 01 00 00 96 00 02 10 00];
				qcom,mdss-dsi-on-command-state = "dsi_lp_mode";
				qcom,mdss-dsi-off-command-state = "dsi_hs_mode";
				qcom,mdss-dsi-nor1-command = [
					15 00 00 00 00 00 02 FE 40
					15 00 00 00 00 00 02 37 80
					15 00 00 00 00 00 02 39 B8
					15 00 00 00 00 00 02 FE 70
					15 00 00 00 00 00 02 A9 2C
					15 00 00 00 00 00 02 FE 00
					15 01 00 00 00 00 02 53 20];
				qcom,mdss-dsi-nor2-command = [
					15 00 00 00 00 00 02 FE 40
					15 00 00 00 00 00 02 37 C0
					15 00 00 00 00 00 02 39 08
					15 00 00 00 00 00 02 FE 70
					15 00 00 00 00 00 02 A9 1B
					15 00 00 00 00 00 02 FE 00
					15 01 00 00 00 00 02 53 E0];
				qcom,mdss-dsi-nor1-command-state = "dsi_hs_mode";
				qcom,mdss-dsi-nor2-command-state = "dsi_hs_mode";
				qcom,mdss-dsi-hbm-on-command = [
					15 00 00 00 00 00 02 FE 40
					15 00 00 00 00 00 02 37 80
					15 00 00 00 00 00 02 39 B8
					15 00 00 00 00 00 02 FE 60
					15 00 00 00 00 00 02 84 0F
					15 00 00 00 00 00 02 86 0C
					15 00 00 00 00 00 02 FE 00
					15 00 00 00 00 00 02 51 FF
					15 01 00 00 00 00 02 53 20];
				qcom,mdss-dsi-hbm-off-command = [
					15 00 00 00 00 00 02 FE 60
					15 00 00 00 00 00 02 84 01
					15 00 00 00 00 00 02 86 8F
					15 01 00 00 00 00 02 FE 00];
				qcom,mdss-dsi-hbm-on-command-state = "dsi_hs_mode";
				qcom,mdss-dsi-hbm-off-command-state = "dsi_hs_mode";
			};
		};
	};
};
